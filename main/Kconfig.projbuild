## main/Kconfig.projbuild
```kconfig
menu "Wi-Fi Configuration"
    config WIFI_SSID
        string "Wi-Fi SSID"
        default "YourWiFiSSID"
    config WIFI_PASS
        string "Wi-Fi Password"
        default "YourWiFiPassword"
    config LICHESS_TOKEN
        string "Lichess API Token"
        default "Bearer YourTokenHere"
endmenu
```
